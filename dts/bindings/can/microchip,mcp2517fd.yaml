## dts/bindings/can/microchip,mcp2517fd.yaml
```yaml
# Copyright (c) 2019 Karsten Koenig
# SPDX-License-Identifier: Apache-2.0

description: MCP2515 SPI CAN controller

compatible: "microchip,mcp2517fd"

include: [spi-device.yaml, can-controller.yaml]

properties:
    osc-freq:
      type: int
      required: true
      description: Frequency of the external oscillator
    int-gpios:
      type: phandle-array
      required: true
      description: |
        Interrupt pin.

        This pin signals active low when produced by the controller. The
        property value should ensure the flags properly describe the signal
        that is presented to the driver.
    pll-enable:
      type: boolean
      required: false
      description: |
        Enable the PLL.

        If the PLL is enabled, the oscillator frequency is multiplied by 10.
        Only works if the oscillator frequency is <= 4 MHz.
    reg:
      type: array
      required: true
    clock:
      type: phandle
      required: false
      description: |
        PWM Clock.

        This clock is used to generate the clock using PWM peripheral.
```

## dts/bindings/serial/st,stm32-uart.yaml
```yaml
description: STM32 UART

compatible: "st,stm32-uart"

include: [uart-controller.yaml, pinctrl-device.yaml]

properties:
    reg:
      required: true

    interrupts:
      required: true

    single-wire:
      type: boolean
      required: false
      description: |
        Enable the single wire half-duplex communication.
        Using this mode, TX and RX lines are internally connected and
        only TX pin is used afterwards and should be configured.
        RX/TX conflicts must be handled on user side.

    swap-tx-rx:
      type: boolean
      required: false
      description: |
        Swap TX and RX pins.
        This is useful when using a UART lines are incorrectly wired.

    pinctrl-0:
      required: true

    pinctrl-names:
      required: true
```
